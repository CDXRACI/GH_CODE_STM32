# file: S1_SYSTEMCLOCK.ioc
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Mcu.Family=STM32F4
Mcu.Name=STM32F411R(C-E)Tx
Mcu.Package=LQFP64
NVIC.PriorityGroup=NVIC_PRIORITYGROUP_4
PA13.Mode=Serial_Wire
PA13.Signal=SYS_JTMS-SWDIO
PA14.Mode=Serial_Wire
PA14.Signal=SYS_JTCK-SWCLK
PA5.Signal=GPIO_Output
PH0\ -\ OSC_IN.Mode=HSE-External-Oscillator
PH0\ -\ OSC_IN.Signal=RCC_OSC_IN
PH1\ -\ OSC_OUT.Mode=HSE-External-Oscillator
PH1\ -\ OSC_OUT.Signal=RCC_OSC_OUT
ProjectManager.HeapSize=0x200
ProjectManager.StackSize=0x400
ProjectManager.TargetToolchain=Makefile
RCC.48MHZClocksFreq_Value=50000000
RCC.AHBFreq_Value=100000000
RCC.APB1CLKDivider=RCC_HCLK_DIV2
RCC.APB1Freq_Value=50000000
RCC.APB1TimFreq_Value=100000000
RCC.APB2Freq_Value=100000000
RCC.APB2TimFreq_Value=100000000
RCC.CortexFreq_Value=100000000
RCC.HCLKFreq_Value=100000000
RCC.HSE_VALUE=25000000
RCC.HSI_VALUE=16000000
RCC.LSE_VALUE=32768
RCC.PLLM=12
RCC.PLLN=96
RCC.PLLSourceVirtual=RCC_PLLSOURCE_HSE
RCC.SYSCLKFreq_VALUE=100000000
RCC.SYSCLKSource=RCC_SYSCLKSOURCE_PLLCLK
RCC.VCOOutputFreq_Value=200000000
board=custom

// file: Core/Src/main.c
/* USER CODE BEGIN Header */
/**
  ******************************************************************************
  * @file           : main.c
  * @brief          : Main program body
  ******************************************************************************
  * @attention
  *
  * Copyright (c) 2022 STMicroelectronics.
  * All rights reserved.
  *
  * This software is licensed under terms that can be found in the LICENSE file
  * in the root directory of this software component.
  * If no LICENSE file comes with this software, it is provided AS-IS.
  *
  ******************************************************************************
  */
/* USER CODE END Header */
#include "main.h"

void SystemClock_Config(void);
static void MX_GPIO_Init(void);
static void SYSTEM_CLOCKCONFIG(void);
/* USER CODE BEGIN PFP */
#define SYSTICK_BASEADDR   0xE000E010

typedef struct
{
	volatile uint32_t CSR;  //SysTick Control and Status Register
	volatile uint32_t RVR;  //SysTick Reload Value Register
	volatile uint32_t CVR; //SysTick Current Value Register
	volatile uint32_t CALIB;    //SysTick Calibration Value Register

}SysTick_RegDef_t;

SysTick_RegDef_t *pSysTick= ((SysTick_RegDef_t*)SYSTICK_BASEADDR);

#define SYSTICK ((SysTick_RegDef_t*)SYSTICK_BASEADDR)

void sysTickDelay_US(uint32_t delay)
{
	//Sets the reload value
	pSysTick->RVR = 16000000/(1000000);

	//Clears the SysTick current value register
	pSysTick->CVR= 0;

	//Enable SysTick in the control register and select internal system clock source
	pSysTick->CSR= (1 << 0) | (1 << 2);

	for(uint32_t i=delay; i > 0; i--)
	{
		while(!(pSysTick->CSR & (1 << 16)));
	}

	//Disable SysTick counter in the Control Register
	pSysTick->CSR=0;
}

void sysTickDelay_MS(uint32_t ms)
{
    // Wait until ms reach zero
    while (ms--)
    {
        // Delay 1ms
        sysTickDelay_US(1000);
    }
}
/* USER CODE END PFP */

int main(void)
{

  /* MCU Configuration--------------------------------------------------------*/

  /* Reset of all peripherals, Initializes the Flash interface and the Systick. */
  HAL_Init();

  /* Configure the system clock */
  SYSTEM_CLOCKCONFIG();

  /* Initialize all configured peripherals */
  MX_GPIO_Init();

  /* Infinite loop */
  /* USER CODE BEGIN WHILE */
  while (1)
  {
    /* SER CODE END WHILE */
RCC->AHB1ENR |= (1<<0);

/*---------------------------------*PA5*------------------------------------------------------*/
GPIOA->MODER |= (1<<10);
GPIOA->OTYPER &= ~(1<<5);  // bit 5=0 --> Output push pull
GPIOA->OSPEEDR |= (1<<11);  // Pin PA5 (bits 11:10) as Fast Speed (1:0)
GPIOA->PUPDR &= ~((1<<10) | (1<<11));  // Pin PA5 (bits 11:10) are 0:0 --> no pull up or pulldown

/*---------------------------------*PC13*-----------------------------------------------------*/
RCC->AHB1ENR |= (1<<2);
GPIOC->MODER &= ~(3<<26);
GPIOC->OTYPER &= ~(1<<13);  // bit 5=0 --> Output push pull
GPIOC->OSPEEDR |= (1<<27);  // Pin PA5 (bits 11:10) as Fast Speed (1:0)
GPIOC->PUPDR |= (1<<27);  // Pin PA5 (bits 11:10) are 0:0 --> no pull up or pulldown

if((GPIOC->IDR & (1<<13)) != 1)
{
GPIOA->ODR |= 1<<5; // Set the Pin PA5
sysTickDelay_MS(1000);
GPIOA->ODR &= ~(1<<5); // Reset the Pin PA5
sysTickDelay_MS(1000);

}

}
}

static void SYSTEM_CLOCKCONFIG(void)
{
#ifndef HSE_VALUE
#define HSE_VALUE (8000000)U
#endif

RCC->APB1ENR |= (1 << 28);
RCC->CR |= 1<<16;

while (!(RCC->CR & (1<<17)));

RCC->CFGR &= ~(1<<4);

RCC->CFGR |= (4<<10);

RCC->CFGR &= ~(1<<13);
#define PLL_M 	4
#define PLL_N 	100
#define PLL_P 	2

RCC->PLLCFGR = (PLL_M <<0) | (PLL_N << 6) | (PLL_P <<16) | (1<<22);
RCC->CR |= (1<<24);
while (!(RCC->CR & (1<<25)));
RCC->CFGR |= (2<<0);
while (!(RCC->CFGR & (2<<2)));
RCC->APB2ENR |= (1<<14);
}

/**************************************************************************************
 *                     INTERRUPT STM32                                                *
 *                                                                                    *
 *                                                                                    *
 * ***********************************************************************************/
void INIT_INTERRUPT(void)
{

RCC->APB2ENR |= (1<<14);  // Enable SYSCNFG
RCC->APB2ENR |= (1<<0);  // Enable AFIO CLOCK

};
void SystemClock_Config(void)
{
  RCC_OscInitTypeDef RCC_OscInitStruct = {0};
  RCC_ClkInitTypeDef RCC_ClkInitStruct = {0};

  /** Configure the main internal regulator output voltage
  */
  __HAL_RCC_PWR_CLK_ENABLE();
  __HAL_PWR_VOLTAGESCALING_CONFIG(PWR_REGULATOR_VOLTAGE_SCALE1);

  /** Initializes the RCC Oscillators according to the specified parameters
  * in the RCC_OscInitTypeDef structure.
  */
  RCC_OscInitStruct.OscillatorType = RCC_OSCILLATORTYPE_HSE;
  RCC_OscInitStruct.HSEState = RCC_HSE_ON;
  RCC_OscInitStruct.PLL.PLLState = RCC_PLL_ON;
  RCC_OscInitStruct.PLL.PLLSource = RCC_PLLSOURCE_HSE;
  RCC_OscInitStruct.PLL.PLLM = 12;
  RCC_OscInitStruct.PLL.PLLN = 96;
  RCC_OscInitStruct.PLL.PLLP = RCC_PLLP_DIV2;
  RCC_OscInitStruct.PLL.PLLQ = 4;
  if (HAL_RCC_OscConfig(&RCC_OscInitStruct) != HAL_OK)
  {
    Error_Handler();
  }

  /** Initializes the CPU, AHB and APB buses clocks
  */
  RCC_ClkInitStruct.ClockType = RCC_CLOCKTYPE_HCLK|RCC_CLOCKTYPE_SYSCLK
                              |RCC_CLOCKTYPE_PCLK1|RCC_CLOCKTYPE_PCLK2;
  RCC_ClkInitStruct.SYSCLKSource = RCC_SYSCLKSOURCE_PLLCLK;
  RCC_ClkInitStruct.AHBCLKDivider = RCC_SYSCLK_DIV1;
  RCC_ClkInitStruct.APB1CLKDivider = RCC_HCLK_DIV2;
  RCC_ClkInitStruct.APB2CLKDivider = RCC_HCLK_DIV1;

  if (HAL_RCC_ClockConfig(&RCC_ClkInitStruct, FLASH_LATENCY_3) != HAL_OK)
  {
    Error_Handler();
  }
}

static void MX_GPIO_Init(void)
{
  GPIO_InitTypeDef GPIO_InitStruct = {0};

  /* GPIO Ports Clock Enable */
  __HAL_RCC_GPIOH_CLK_ENABLE();
  __HAL_RCC_GPIOA_CLK_ENABLE();

  /*Configure GPIO pin Output Level */
  HAL_GPIO_WritePin(GPIOA, GPIO_PIN_5, GPIO_PIN_RESET);

  /*Configure GPIO pin : PA5 */
  GPIO_InitStruct.Pin = GPIO_PIN_5;
  GPIO_InitStruct.Mode = GPIO_MODE_OUTPUT_PP;
  GPIO_InitStruct.Pull = GPIO_NOPULL;
  GPIO_InitStruct.Speed = GPIO_SPEED_FREQ_LOW;
  HAL_GPIO_Init(GPIOA, &GPIO_InitStruct);

}

void Error_Handler(void)
{
  __disable_irq();
  while (1)
  {
  }
}
